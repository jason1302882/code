## kernel4.14/drivers/input/touchscreen/focaltech/Kconfig
```kconfig
#
# FOCALTECH touchscreen module
#

config TOUCHSCREEN_FOCALTECH
        tristate "FOCALTECH touchscreen driver"
        depends on I2C
        help
          Say Y here if you have a FOCALTECH based touchscreen
          controller.

          If unsure, say N.

          To compile this driver as a module, choose M here: the
          module will be called focaltech.c.
```

## kernel4.14/drivers/input/touchscreen/gslX680/Kconfig
```kconfig
#
# GSLX680 touchscreen module
#

config TOUCHSCREEN_GSLX680
        tristate "GSLX680 touchscreen driver"
        depends on I2C
        help
          Say Y here if you have a GSLX680 based touchscreen
          controller.

          If unsure, say N.

          To compile this driver as a module, choose M here: the
          module will be called gslX680_ts.c.
```

## kernel4.14/drivers/input/touchscreen/gt9xx/Kconfig
```kconfig
#
# FOCALTECH touchscreen module
#

config TOUCHSCREEN_GT9XX
        tristate "GT9XX touchscreen driver"
        depends on I2C
        help
          Say Y here if you have a GT9XX based touchscreen
          controller.

          If unsure, say N.

          To compile this driver as a module, choose M here: the
          module will be called gt9xx.c.
```
